// SPDX-License-Identifier: MIT
// Optional golden-vector generator; compile with the pinned perfect6502 source.
// The external source retains its MIT notice. No user firmware is involved.
#include <stdio.h>
#include "perfect6502.c"
#include "irq_program.h"
int main(void) {
    puts("// SPDX-License-Identifier: MIT\n// Generated by irq_oracle.c using perfect6502 09fc542877a84318291aa42dab143a3e2c3db974.\n// IRQ entry timing and stack bytes, not a full bus trace.\nstruct IRQExpected { int cycle; unsigned pc, status; };\nstatic const IRQExpected irq_expected[IRQ_SCENARIOS][40] = {");
    for(unsigned scenario=0;scenario<IRQ_SCENARIOS;++scenario) {
        printf("    { // %s\n",irq_names[scenario]);
        for(unsigned phase=1;phase<=40;++phase) {
            irq_program(memory,scenario);void *chip=initAndResetChip();
            int origin=-1,handler=-1;unsigned count=0,pushed[3]={0},skip=irq_program_pushes[scenario];
            for(int tick=0;tick<175;++tick) {
                if(origin>=0&&tick-origin==(int)phase) {
                    setNode(chip,irq,0);recalcNodeList(chip);
                }
                step(chip);step(chip);unsigned address=readAddressBus(chip);
                if(origin<0&&address==0x1100)origin=tick;
                if(origin>=0&&handler<0) {
                    if(!readRW(chip)&&address>=0x100&&address<0x200) {
                        if(skip)--skip;
                        else {
                            if(count>=3||address!=0x1fd-irq_program_pushes[scenario]-count)return 2;
                            pushed[count++]=readDataBus(chip);
                        }
                    }
                    if(address==0x2000)handler=tick-origin;
                }
            }
            destroyChip(chip);
            if(origin<0||(handler>=0&&count!=3)||(handler<0&&count))return 2;
            printf("        {%d,0x%04x,0x%02x}%s\n",handler,
                (pushed[0]<<8)|pushed[1],pushed[2],phase<40?",":"");
        }
        printf("    }%s\n",scenario+1<IRQ_SCENARIOS?",":"");
    }
    puts("};");return 0;
}
