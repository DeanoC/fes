/* Generated by Yosys 0.70+ (git sha1 0a7927bf1, Release, GNU /usr/bin/c++ 14.2.0) [github.com/DeanoC/yosys at HEAD] */

(* top =  1  *)
(* src = "<repo>/docs/validation/2026-11-10-1581-mlab-inference/rtl/s1d_harness.sv:12.1-34.10" *)
module s1d_harness(clk, din, dout);
  input clk;
  wire clk;
  input din;
  wire din;
  output dout;
  wire dout;
  wire [31:0] _00_;
  wire [31:0] _01_;
  wire _02_;
  wire _03_;
  wire [3:0] _04_;
  wire [3:0] _05_;
  wire [31:0] _06_;
  wire [31:0] _07_;
  wire [3:0] _08_;
  wire [31:0] _09_;
  wire [31:0] _10_;
  wire [3:0] _11_;
  wire [3:0] _12_;
  wire [3:0] _13_;
  reg [3:0] ras_ptr ;
  wire [3:0] ras_ptr_next ;
  reg [31:0] ras_top ;
  wire [3:0] ras_wa ;
  wire [31:0] ras_wd ;
  wire ras_we ;
  reg [31:0] sig;
  reg [72:0] sr;
  reg [31:0] top_q;
  (* ramstyle = "MLAB, no_rw_check" *)
  reg [31:0] ras_stack  [15:0];
  always @(posedge clk) begin
    if (_10_[0])
      ras_stack [_08_] <= _09_;
  end
  assign _06_ = ras_stack [ras_ptr_next ];
  assign _00_ = sr[0] ? ras_top  : sr[32:1];
  assign _01_ = { sig[30:0], sig[31] } ^ top_q;
  assign ras_we  = _02_ && _03_;
  assign _02_ = ! sr[72];
  assign _03_ = sr[71] ? sr[66] : sr[33];
  assign _04_ = ras_ptr  + 4'h1;
  assign ras_wa  = sr[71] ? sr[70:67] : _04_;
  assign ras_wd  = sr[71] ? sr[65:34] : sr[32:1];
  assign _05_ = ras_ptr  - 4'h1;
  assign _07_ = ras_we  ? ras_wd  : _06_;
  (* \always_ff  = 32'd1 *)
  always @(posedge clk)
    ras_top  <= _07_;
  (* \always_ff  = 32'd1 *)
  always @(posedge clk)
    ras_ptr  <= ras_ptr_next ;
  assign _10_[0] = ras_we  ? (* full_case = 32'd1 *) 1'h1 : 1'h0;
  assign _09_ = ras_we  ? (* full_case = 32'd1 *) ras_wd  : 32'hxxxxxxxx;
  assign _08_ = ras_we  ? (* full_case = 32'd1 *) ras_wa  : 4'hx;
  assign _13_ = sr[0] ? (* full_case = 32'd1 *) _05_ : ras_ptr ;
  assign _12_ = sr[33] ? (* full_case = 32'd1 *) _04_ : _13_;
  assign _11_ = sr[71] ? (* full_case = 32'd1 *) sr[70:67] : _12_;
  assign ras_ptr_next  = sr[72] ? (* full_case = 32'd1 *) 4'h0 : _11_;
  (* \always_ff  = 32'd1 *)
  always @(posedge clk)
    sr <= { sr[71:0], din };
  (* \always_ff  = 32'd1 *)
  always @(posedge clk)
    top_q <= _00_;
  (* \always_ff  = 32'd1 *)
  always @(posedge clk)
    sig <= _01_;
  assign _10_[31:1] = { _10_[0], _10_[0], _10_[0], _10_[0], _10_[0], _10_[0], _10_[0], _10_[0], _10_[0], _10_[0], _10_[0], _10_[0], _10_[0], _10_[0], _10_[0], _10_[0], _10_[0], _10_[0], _10_[0], _10_[0], _10_[0], _10_[0], _10_[0], _10_[0], _10_[0], _10_[0], _10_[0], _10_[0], _10_[0], _10_[0], _10_[0] };
  assign dout = sig[31];
endmodule
