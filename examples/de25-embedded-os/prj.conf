## CMakeLists.txt
```
cmake_minimum_required(VERSION 3.20.0)
find_package(Zephyr REQUIRED HINTS $ENV{ZEPHYR_BASE})
project(fes_embedded_probe LANGUAGES C CXX)

target_sources(app PRIVATE src/probe.cpp src/selftest.cpp src/main.cpp)
target_include_directories(app PRIVATE src
  ${CMAKE_CURRENT_SOURCE_DIR}/../../sources/libmister-runtime/src)
target_compile_features(app PRIVATE cxx_std_14)
```

## prj.conf
```kconfig
CONFIG_CPP=y
CONFIG_STD_CPP14=y
CONFIG_MAIN_STACK_SIZE=4096
CONFIG_PRINTK=y
CONFIG_CONSOLE=y
CONFIG_SERIAL=y
CONFIG_UART_CONSOLE=y
```

## src/main.cpp
```c
// SPDX-License-Identifier: GPL-3.0-or-later
#include "probe.hpp"

#ifdef __ZEPHYR__
#include <zephyr/kernel.h>
#include <zephyr/sys/printk.h>
#define PROBE_PRINT printk
static std::uint64_t clock_us()
{
    return k_cyc_to_us_floor64(k_cycle_get_64());
}
// A bounded hint lets Link detect timer stalls; do not busy-wait on the timer.
static void idle() { asm volatile("yield"); }
#else
#include <cstdio>
#define PROBE_PRINT std::printf
#endif

static void report(const char* name, bool ok)
{
    PROBE_PRINT("%s %s\n", ok ? "PASS" : "FAIL", name);
}

int main()
{
    PROBE_PRINT("FES exploratory GP probe; transport=emulated; no board MMIO\n");
    bool passed = false;
#ifdef __ZEPHYR__
    const unsigned count = fes_probe::selftest(report, &passed, clock_us, idle);
#else
    const unsigned count = fes_probe::selftest(report, &passed);
#endif
    PROBE_PRINT("FES_EMBEDDED_PROBE %s tests=%u transport=emulated\n",
                passed ? "PASS" : "FAIL", count);
    return passed ? 0 : 1;
}
```

## src/probe.cpp
```c
// SPDX-License-Identifier: GPL-3.0-or-later
#include "probe.hpp"

namespace fes_probe {
namespace {
constexpr std::uint32_t fixed_mask =
    ~(gp::FesGpAckMask | gp::FesGpErrorMask | gp::FesGpResponseMask);
// Finite limits also terminate a frozen timer. The normal deadline wins when
// time progresses; backwards time is invalid. Callbacks themselves must return.
struct PollBudget {
    std::uint64_t last;
    std::uint64_t deadline;
    unsigned polls = 0;
    unsigned stalled = 0;
    bool step(const Port& port, std::uint64_t* now)
    {
        *now = port.now_us(port.context);
        if (*now < last || *now >= deadline || ++polls > 1000000u) return false;
        stalled = *now == last ? stalled + 1u : 0u;
        last = *now;
        return stalled <= 4096u;
    }
};

std::uint32_t field(std::uint32_t value, std::uint32_t mask)
{
    return value * (mask & (~mask + 1u));
}
}

Result Link::ambiguous(Result result)
{
    poisoned_ = true;
    identified_ = false;
    return result;
}

Result Link::exchange(std::uint8_t opcode, std::uint8_t index,
                      std::uint16_t argument, std::uint64_t deadline,
                      std::uint16_t* response)
{
    if (response == nullptr || opcode > 127u || !port_.read || !port_.write ||
        !port_.now_us || !port_.idle) return Result::invalid;
    if (poisoned_) return Result::poisoned;
    const std::uint64_t started = port_.now_us(port_.context);
    if (started >= deadline) return Result::timeout;
    // Preserve production's maximum 100 ms exchange. Subtraction avoids
    // overflow near the end of the clock's range.
    if (deadline - started > 100000u) deadline = started + 100000u;
    PollBudget budget{started, deadline};
    if (!initialized_) {
        // Reset-only probe: validate ACK=0 read-only before even the settled
        // write. Otherwise that write could itself become a command edge.
        bool have_sample = false;
        std::uint32_t previous = 0;
        std::uint64_t guard_start = started;
        for (;;) {
            std::uint64_t now;
            if (!budget.step(port_, &now)) return ambiguous(Result::timeout);
            std::uint32_t observed;
            if (!port_.read(port_.context, &observed)) return ambiguous(Result::io);
            if ((observed & fixed_mask) != gp::FesGpSignature ||
                (observed & gp::FesGpAckMask) != 0) return ambiguous(Result::protocol);
            if (have_sample && observed == previous && now - guard_start >= 1u) {
                if (!budget.step(port_, &now)) return ambiguous(Result::timeout);
                initialized_ = true;
                break;
            }
            if (!have_sample || observed != previous) guard_start = now;
            have_sample = true;
            previous = observed;
            port_.idle(port_.context);
        }
    }
    const std::uint32_t fields = field(opcode, gp::FesGpOpcodeMask) |
        field(index, gp::FesGpIndexMask) | field(argument, gp::FesGpArgumentMask);
    if (!port_.write(port_.context, fields | (toggle_ ? gp::FesGpRequestMask : 0u)))
        return Result::io;
    toggle_ = !toggle_;
    if (!port_.write(port_.context, fields | (toggle_ ? gp::FesGpRequestMask : 0u)))
        return ambiguous(Result::io);

    bool ack_seen = false;
    bool have_sample = false;
    std::uint32_t previous = 0;
    std::uint64_t guard_start = 0;
    for (;;) {
        std::uint64_t now;
        if (!budget.step(port_, &now)) return ambiguous(Result::timeout);
        if (ack_seen && now - guard_start < 1u) {
            port_.idle(port_.context);
            continue;
        }
        std::uint32_t observed = 0;
        if (!port_.read(port_.context, &observed)) return ambiguous(Result::io);
        if ((observed & fixed_mask) != gp::FesGpSignature)
            return ambiguous(Result::protocol);
        const bool ack = (observed & gp::FesGpAckMask) != 0;
        if (ack != toggle_) {
            if (ack_seen) return ambiguous(Result::protocol);
        } else if (!ack_seen) {
            ack_seen = true;
            if (!budget.step(port_, &guard_start)) return ambiguous(Result::timeout);
        } else {
            if (!budget.step(port_, &now)) return ambiguous(Result::timeout);
            if (have_sample && observed == previous) {
                *response = static_cast<std::uint16_t>(observed & gp::FesGpResponseMask);
                return (observed & gp::FesGpErrorMask) ? Result::rejected : Result::ok;
            }
            have_sample = true;
            previous = observed;
        }
        port_.idle(port_.context);
    }
}

Result Link::identify(const Identity& expected, std::uint64_t deadline)
{
    identified_ = false;
    Identity observed = {};
    for (unsigned i = 0; i < gp::FesGpIdentityWordCount; ++i) {
        const Result result = exchange(gp::FesGpOpcodeIdentity,
            static_cast<std::uint8_t>(i), 0, deadline, &observed.word[i]);
        if (result != Result::ok) return result;
    }
    for (unsigned i = 0; i < gp::FesGpIdentityWordCount; ++i)
        if (observed.word[i] != expected.word[i]) return Result::identity_mismatch;
    identified_ = true;
    return Result::ok;
}

Result Link::execution(bool release, std::uint64_t deadline)
{
    if (!identified_) return Result::not_identified;
    std::uint16_t response = 0;
    return exchange(gp::FesGpOpcodeGameplay, gp::FesGpControlIndex,
        release ? gp::FesGpGameplayRelease : gp::FesGpGameplayHoldReset,
        deadline, &response);
}

Result Link::buttons(std::uint16_t value, std::uint64_t deadline)
{
    if (!identified_) return Result::not_identified;
    if ((value & ~gp::FesGpButtonMask) != 0) return Result::invalid;
    std::uint16_t response = 0;
    return exchange(gp::FesGpOpcodeButtons, gp::FesGpControlIndex,
                    value, deadline, &response);
}
} // namespace fes_probe
```

## src/probe.hpp
```c
// SPDX-License-Identifier: GPL-3.0-or-later
#pragma once

#include <cstdint>
#include "native/generated/fes_gp.hpp"

namespace fes_probe {
namespace gp = mister::native::generated;

// The owner serializes calls. No MMIO address, filesystem, allocator or OS ABI
// is assumed. Every callback must return in bounded time. Clock regressions,
// 4096 consecutive unchanged samples or one million polls fail closed, even
// when the timer stops. The reset-only probe requires stable initial ACK=0.
struct Port {
    void* context;
    bool (*read)(void*, std::uint32_t*);
    bool (*write)(void*, std::uint32_t);
    std::uint64_t (*now_us)(void*);
    void (*idle)(void*);
};

enum class Result { ok, invalid, timeout, io, protocol, rejected, poisoned,
                    identity_mismatch, not_identified };

struct Identity { std::uint16_t word[gp::FesGpIdentityWordCount]; };

class Link {
public:
    explicit Link(Port port) : port_(port) {}
    Result exchange(std::uint8_t opcode, std::uint8_t index,
                    std::uint16_t argument, std::uint64_t deadline_us,
                    std::uint16_t* response);
    Result identify(const Identity& expected, std::uint64_t deadline_us);
    Result execution(bool release, std::uint64_t deadline_us);
    Result buttons(std::uint16_t buttons, std::uint64_t deadline_us);
    bool poisoned() const { return poisoned_; }
private:
    Result ambiguous(Result result);
    Port port_;
    bool initialized_ = false;
    bool toggle_ = false;
    bool poisoned_ = false;
    bool identified_ = false;
};

using Report = void (*)(const char*, bool);
unsigned selftest(Report report, bool* passed,
                  std::uint64_t (*clock_us)() = nullptr,
                  void (*idle)() = nullptr);
} // namespace fes_probe
```

## src/selftest.cpp
```c
// SPDX-License-Identifier: GPL-3.0-or-later
#include "probe.hpp"

namespace fes_probe {
namespace {
enum class Fault { none, late_ack, timeout, reject, bad_signature, revert_ack,
                   unstable, read_error, toggle_write_error };

Identity fixture_identity()
{
    Identity identity = {};
    identity.word[gp::FesGpIdentityMagic0Index] = gp::FesGpIdentityMagic0;
    identity.word[gp::FesGpIdentityMagic1Index] = gp::FesGpIdentityMagic1;
    identity.word[gp::FesGpIdentityTransportMajorIndex] = gp::FesGpTransportMajor;
    identity.word[gp::FesGpIdentityTransportMinorIndex] = gp::FesGpTransportMinor;
    identity.word[gp::FesGpIdentityAbiTagIndex] = gp::FesGpAbiTag;
    identity.word[gp::FesGpIdentityAbiMajorIndex] = gp::FesGpAbiMajor;
    identity.word[gp::FesGpIdentityAbiMinorIndex] = gp::FesGpAbiMinor;
    identity.word[gp::FesGpIdentityCapabilitiesIndex] =
        gp::FesGpCapabilityGamepad | gp::FesGpCapabilityVideoFixed720p60;
    // Synthetic expected build identity, not an admitted package receipt.
    for (unsigned i = 0; i < 8; ++i)
        identity.word[gp::FesGpIdentityBuildIDStartIndex + i] = 0x1000u + i;
    return identity;
}

// This emulates only the GP register responder. It is not a DE25 FPGA model.
struct Model {
    Fault fault = Fault::none;
    Identity identity = fixture_identity();
    std::uint64_t virtual_us = 0;
    std::uint64_t (*clock)() = nullptr;
    void (*pause)() = nullptr;
    std::uint32_t response = gp::FesGpSignature;
    std::uint32_t first_writes[2] = {};
    unsigned writes = 0, commands = 0, reads = 0;
    bool ack = false, running = false;
    std::uint16_t buttons = 0;
    std::uint64_t first_ack_us = 0, confirmed_us = 0;
    unsigned ack_samples = 0;
    bool freeze_before_write = false, freeze_after_write = false;
    bool backwards_before_write = false, backwards_after_write = false;
    std::uint64_t frozen_us = 0;

    static bool read(void* context, std::uint32_t* value)
    {
        Model& m = *static_cast<Model*>(context);
        ++m.reads;
        if (m.commands && m.fault == Fault::read_error) return false;
        *value = m.response;
        if (m.commands) {
            if (m.fault == Fault::bad_signature) *value ^= 0x01000000u;
            if (m.fault == Fault::timeout ||
                (m.fault == Fault::late_ack && m.reads <= 3) ||
                (m.fault == Fault::revert_ack && m.reads > 1))
                *value ^= gp::FesGpAckMask;
            if (m.fault == Fault::unstable) *value ^= (m.reads & 1u);
        }
        if (((*value & gp::FesGpAckMask) != 0) == m.ack) {
            if (m.ack_samples == 0) m.first_ack_us = now(context);
            else if (m.ack_samples == 1) m.confirmed_us = now(context);
            ++m.ack_samples;
        }
        return true;
    }
    static bool write(void* context, std::uint32_t value)
    {
        Model& m = *static_cast<Model*>(context);
        if (m.writes < 2) m.first_writes[m.writes] = value;
        ++m.writes;
        if (m.fault == Fault::toggle_write_error && m.writes == 2) return false;
        const bool requested = (value & gp::FesGpRequestMask) != 0;
        if (requested == m.ack) return true;
        m.ack = requested;
        if (m.freeze_after_write || m.backwards_after_write) m.frozen_us = now(&m);
        ++m.commands;
        m.reads = 0;
        m.ack_samples = 0;
        const unsigned opcode = (value & gp::FesGpOpcodeMask) >> 24;
        const unsigned index = (value & gp::FesGpIndexMask) >> 16;
        const std::uint16_t argument = value & gp::FesGpArgumentMask;
        std::uint16_t payload = 0;
        bool error = m.fault == Fault::reject;
        if (opcode == gp::FesGpOpcodeIdentity && index < gp::FesGpIdentityWordCount)
            payload = m.identity.word[index];
        else if (opcode == gp::FesGpOpcodeGameplay)
            m.running = argument == gp::FesGpGameplayRelease;
        else if (opcode == gp::FesGpOpcodeButtons)
            m.buttons = argument;
        else error = true;
        if (error) payload = gp::FesGpErrorInvalidOpcode;
        m.response = gp::FesGpSignature | (m.ack ? gp::FesGpAckMask : 0u) |
            (error ? gp::FesGpErrorMask : 0u) | payload;
        return true;
    }
    static std::uint64_t now(void* context)
    {
        Model& m = *static_cast<Model*>(context);
        if (m.freeze_before_write || (m.commands && m.freeze_after_write)) return m.frozen_us;
        if (m.backwards_before_write || (m.commands && m.backwards_after_write)) return m.frozen_us--;
        return m.clock ? m.clock() : m.virtual_us;
    }
    static void idle(void* context)
    {
        Model& m = *static_cast<Model*>(context);
        if (m.pause) m.pause();
        else ++m.virtual_us;
    }
    Port port() { return {this, read, write, now, idle}; }
    std::uint64_t deadline() { return now(this) + 20000u; }
};
}

unsigned selftest(Report report, bool* passed, std::uint64_t (*clock_us)(),
                  void (*idle)())
{
    unsigned count = 0;
    *passed = true;
    auto check = [&](const char* name, bool ok) {
        ++count;
        *passed = *passed && ok;
        report(name, ok);
    };
    auto model = [&]() {
        Model m;
        m.clock = clock_us;
        m.pause = idle;
        return m;
    };
    const Identity expected = fixture_identity();
    {
        Model m = model();
        Link link(m.port());
        check("identity-before-release", link.execution(true, m.deadline()) ==
            Result::not_identified && m.writes == 0);
        bool ok = link.identify(expected, m.deadline()) == Result::ok &&
            m.commands == 16;
        ok = ok && link.execution(true, m.deadline()) == Result::ok && m.running;
        ok = ok && link.buttons(gp::FesGpButtonA, m.deadline()) == Result::ok &&
            m.buttons == gp::FesGpButtonA;
        ok = ok && link.buttons(0, m.deadline()) == Result::ok && m.buttons == 0;
        ok = ok && link.execution(false, m.deadline()) == Result::ok && !m.running;
        check("identity-release-input-neutralize-hold", ok && m.commands == 20);
    }
    {
        Model m = model();
        Link link(m.port());
        std::uint16_t response = 0;
        const Result result = link.exchange(gp::FesGpOpcodeIdentity, 8, 0,
                                           m.deadline(), &response);
        check("settled-fields-then-toggle-wire-vector", result == Result::ok &&
            response == 0x1000u && m.first_writes[0] == 0x01080000u &&
            m.first_writes[1] == 0x81080000u && m.writes == 2 && m.reads >= 3 &&
            m.confirmed_us - m.first_ack_us >= 1u);
    }
    {
        Model m = model();
        m.identity.word[gp::FesGpIdentityBuildIDStartIndex + 7] ^= 1u;
        Link link(m.port());
        check("build-identity-mismatch-blocks-release", link.identify(expected,
            m.deadline()) == Result::identity_mismatch &&
            link.execution(true, m.deadline()) == Result::not_identified &&
            m.commands == 16 && !m.running);
    }
    {
        bool ok = true;
        for (unsigned word = 0; word < gp::FesGpIdentityWordCount; ++word) {
            Model m = model();
            m.identity.word[word] ^= 1u;
            Link link(m.port());
            ok = ok && link.identify(expected, m.deadline()) == Result::identity_mismatch &&
                link.execution(true, m.deadline()) == Result::not_identified && !m.running;
        }
        check("every-identity-word-is-checked", ok);
    }
    const Fault faults[] = {Fault::late_ack, Fault::timeout, Fault::reject,
        Fault::bad_signature, Fault::revert_ack, Fault::unstable,
        Fault::read_error, Fault::toggle_write_error};
    const Result results[] = {Result::ok, Result::timeout, Result::rejected,
        Result::protocol, Result::protocol, Result::timeout,
        Result::io, Result::io};
    const char* names[] = {"late-ack-no-replay", "timeout-poisons-no-replay",
        "completed-rejection-preserves-toggle", "invalid-signature-poisons",
        "reverted-ack-poisons", "unstable-payload-times-out",
        "read-failure-poisons", "toggle-write-failure-poisons"};
    for (unsigned i = 0; i < sizeof(faults) / sizeof(faults[0]); ++i) {
        Model m = model();
        m.fault = faults[i];
        Link link(m.port());
        std::uint16_t response = 0;
        const Result result = link.exchange(gp::FesGpOpcodeIdentity, 0, 0,
                                           m.deadline(), &response);
        const unsigned writes = m.writes;
        const bool ambiguous = results[i] != Result::ok && results[i] != Result::rejected;
        bool ok = result == results[i] && link.poisoned() == ambiguous && writes == 2;
        m.fault = Fault::none;
        const Result next = link.exchange(gp::FesGpOpcodeIdentity, 1, 0,
                                         m.deadline(), &response);
        ok = ok && (ambiguous ? next == Result::poisoned && m.writes == writes :
                               next == Result::ok && m.writes == writes + 2);
        check(names[i], ok);
    }
    {
        Model m = model();
        Link link(m.port());
        std::uint16_t response = 0;
        check("expired-deadline-does-not-write", link.exchange(1, 0, 0,
            Model::now(&m), &response) == Result::timeout && m.writes == 0);
    }
    {
        Model m = model();
        Link link(m.port());
        std::uint16_t response = 0;
        check("invalid-request-does-not-write", link.exchange(128, 0, 0,
            m.deadline(), &response) == Result::invalid &&
            link.exchange(1, 0, 0, m.deadline(), nullptr) == Result::invalid && m.writes == 0);
    }
    {
        Model m = model();
        m.fault = Fault::timeout;
        Link link(m.port());
        const std::uint64_t before = Model::now(&m);
        std::uint16_t response = 0;
        const Result result = link.exchange(1, 0, 0, before + 1000000u, &response);
        const std::uint64_t elapsed = Model::now(&m) - before;
        check("long-deadline-is-capped-at-100ms", result == Result::timeout &&
            elapsed >= 100000u && elapsed < 200000u && m.writes == 2);
    }
    {
        Model m = model();
        m.ack = true;
        m.response |= gp::FesGpAckMask;
        Link link(m.port());
        std::uint16_t response = 0;
        check("initial-ack-one-rejected-without-writes", link.exchange(1, 0, 0,
            m.deadline(), &response) == Result::protocol && m.writes == 0 && m.commands == 0);
    }
    {
        Model m = model();
        m.response ^= 0x01000000u;
        Link link(m.port());
        std::uint16_t response = 0;
        check("invalid-initial-response-rejected-without-writes", link.exchange(1, 0, 0,
            m.deadline(), &response) == Result::protocol && m.writes == 0);
    }
    for (unsigned kind = 0; kind < 4; ++kind) {
        Model m = model();
        m.frozen_us = 100000u;
        m.freeze_before_write = kind == 0;
        m.backwards_before_write = kind == 1;
        m.freeze_after_write = kind == 2;
        m.backwards_after_write = kind == 3;
        Link link(m.port());
        std::uint16_t response = 0;
        const Result result = link.exchange(1, 0, 0, 2000000u, &response);
        const unsigned writes = m.writes;
        const char* names[] = {"flat-initial-clock-no-write", "backwards-initial-clock-no-write",
            "flat-ack-guard-poisons", "backwards-ack-guard-poisons"};
        check(names[kind], result == Result::timeout && link.poisoned() &&
            writes == (kind < 2 ? 0u : 2u) &&
            link.exchange(1, 0, 0, 2000000u, &response) == Result::poisoned && m.writes == writes);
    }
    return count;
}
} // namespace fes_probe
```
