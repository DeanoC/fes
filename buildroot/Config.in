## buildroot/Config.in
```kconfig
menu "FogCast target"
source "$BR2_EXTERNAL_FOGCAST_TARGET_PATH/package/mister-runtime/Config.in"
endmenu
```

## buildroot/configs/fogcast_target_native_dev_defconfig
```kconfig
BR2_arm=y
BR2_cortex_a9=y
BR2_ARM_ENABLE_VFP=y
BR2_ARM_EABIHF=y
BR2_TOOLCHAIN_BUILDROOT_GLIBC=y
BR2_INIT_BUSYBOX=y
BR2_ROOTFS_DEVICE_CREATION_DYNAMIC_MDEV=y
BR2_ROOTFS_MERGED_USR=y
BR2_TARGET_GENERIC_HOSTNAME="mister"
BR2_TARGET_GENERIC_ISSUE="FogCast target"
BR2_TARGET_ENABLE_ROOT_LOGIN=y
BR2_TARGET_GENERIC_ROOT_PASSWD="$$6$$fogcasttarget$$mDPhauly/TKN0BXCs62CAmOERiiUBe0HDeSNhVNWZTZ8nhYPYujeCUbpgjh.qmySRPhEDnCE5GtY/YTG5JyUR1"
# BR2_TARGET_GENERIC_REMOUNT_ROOTFS_RW is not set
BR2_SYSTEM_DHCP=""
BR2_REPRODUCIBLE=y
BR2_PRIMARY_SITE="https://sources.buildroot.net"
BR2_GLOBAL_PATCH_DIR="${BR2_EXTERNAL_FOGCAST_TARGET_PATH}/board/fogcast-target/patches"
BR2_TOOLCHAIN_BUILDROOT_CXX=y
BR2_PACKAGE_IMLIB2=y
BR2_PACKAGE_IMLIB2_PNG=y
BR2_PACKAGE_FREETYPE=y
BR2_PACKAGE_LIBPNG=y
BR2_PACKAGE_BZIP2=y
BR2_PACKAGE_ZLIB=y
BR2_PACKAGE_BLUEZ5_UTILS=y
BR2_PACKAGE_DROPBEAR=y
BR2_PACKAGE_LIBCURL=y
BR2_PACKAGE_LIBCURL_CURL=y
BR2_PACKAGE_FOGCAST_MISTER_RUNTIME=y
BR2_TARGET_ROOTFS_EXT2=y
BR2_TARGET_ROOTFS_EXT2_4=y
BR2_TARGET_ROOTFS_EXT2_SIZE="64M"
BR2_TARGET_ROOTFS_EXT2_MKFS_OPTIONS="-U 9b3652c2-33f1-4a6b-9a53-9b667ab1b001 -E lazy_itable_init=0,lazy_journal_init=0,hash_seed=9b3652c2-33f1-4a6b-9a53-9b667ab1b001"
BR2_ROOTFS_OVERLAY="${BR2_EXTERNAL_FOGCAST_TARGET_PATH}/board/fogcast-target/rootfs-overlay ${BR2_EXTERNAL_FOGCAST_TARGET_PATH}/board/fogcast-target/native-rootfs-overlay"
BR2_ROOTFS_POST_BUILD_SCRIPT="${BR2_EXTERNAL_FOGCAST_TARGET_PATH}/board/fogcast-target/post-build.sh ${BR2_EXTERNAL_FOGCAST_TARGET_PATH}/board/fogcast-target/native-post-build.sh"
```

## image/buildroot/configs/fogcast_toolchain_only_defconfig
```kconfig
BR2_INIT_NONE=y
BR2_TARGET_GENERIC_GETTY_PORT=""
BR2_ROOTFS_DEVICE_CREATION_STATIC=y
```

## image/buildroot/package/mister-runtime/Config.in
```kconfig
config BR2_PACKAGE_FOGCAST_MISTER_RUNTIME
	bool "mister-runtime"
	depends on BR2_INSTALL_LIBSTDCPP
	help
	  Build and install the pinned native MiSTer runtime daemon from the
	  verified read-only source checkout mounted at /runtime-source.

config BR2_PACKAGE_MISTER_RUNTIME
	bool
	default y if BR2_PACKAGE_FOGCAST_MISTER_RUNTIME
```

## image/de25-nano/rootfs/defconfig
```kconfig
BR2_aarch64=y
BR2_cortex_a53=y
BR2_TOOLCHAIN_BUILDROOT_GLIBC=y
BR2_GCC_VERSION_9_X=y
BR2_TOOLCHAIN_BUILDROOT_CXX=y
BR2_KERNEL_HEADERS_5_10=y
BR2_REPRODUCIBLE=y
BR2_INIT_BUSYBOX=y
BR2_ROOTFS_DEVICE_CREATION_DYNAMIC_MDEV=y
BR2_TARGET_GENERIC_HOSTNAME="fes-de25-nano"
BR2_TARGET_GENERIC_ISSUE="FES DE25-Nano Linux bring-up"
BR2_TARGET_ENABLE_ROOT_LOGIN=y
BR2_TARGET_GENERIC_ROOT_PASSWD="$$6$$fogcasttarget$$mDPhauly/TKN0BXCs62CAmOERiiUBe0HDeSNhVNWZTZ8nhYPYujeCUbpgjh.qmySRPhEDnCE5GtY/YTG5JyUR1"
BR2_TARGET_GENERIC_GETTY_PORT="ttyS0"
BR2_TARGET_GENERIC_GETTY_BAUDRATE_115200=y
BR2_TARGET_GENERIC_GETTY_TERM="vt100"
BR2_TARGET_GENERIC_REMOUNT_ROOTFS_RW=y
BR2_SYSTEM_DHCP="eth0"
BR2_PACKAGE_DROPBEAR=y
# BR2_PACKAGE_DROPBEAR_CLIENT is not set
BR2_PACKAGE_DROPBEAR_DISABLE_REVERSEDNS=y
BR2_TARGET_ROOTFS_EXT2=y
BR2_TARGET_ROOTFS_EXT2_4=y
BR2_TARGET_ROOTFS_EXT2_SIZE="128M"
BR2_TARGET_ROOTFS_TAR=y
BR2_ROOTFS_OVERLAY="@ROOTFS_DIR@/overlay @KERNEL_MODULES_DIR@"
BR2_ROOTFS_POST_BUILD_SCRIPT="@ROOTFS_DIR@/post-build.sh"
```

## image/kernel/de25-dma/Kconfig
```kconfig
config FES_DE25_DMA
	tristate "FES DE25 DMA ownership diagnostic"
	depends on MMU && HAS_DMA && OF
	help
	  Kernel-owned coherent DMA storage and revocable client mappings.
	  DE25 production binding always refuses until actual device translation,
	  firewall and boot/reset lifetime requirements have been established.

config FES_DE25_DMA_KUNIT_TEST
	bool "KUnit tests for FES DE25 DMA ownership"
	depends on KUNIT && FES_DE25_DMA=y
	help
	  Run the actual allocation, file operations and lifetime code against a
	  KUnit test device and a private scripted transport under a test kernel.
	  This does not admit or emulate DE25 hardware.

config FES_DE25_DMA_PLATFORM
	bool "DE25 permanent Linux DMA owner candidate"
	depends on FES_DE25_DMA=y && IOMMU_API && OF_OVERLAY
	default n
	help
	  Unfinished physical provider, disabled in ordinary builds. Requires a
	  permanent base-tree device, translated DMA domain and protected built-in
	  SMMU/region/manager/bridge suppliers. The current shipping kernel does not
	  meet this binding contract. This does not enable normal FES admission.
```
