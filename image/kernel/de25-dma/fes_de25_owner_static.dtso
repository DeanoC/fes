// SPDX-License-Identifier: GPL-2.0
/dts-v1/;
/plugin/;

/ {
	fragment@0 {
		target-path = "/fes-de25-kunit-region";
		__overlay__ {
			firmware-name = "fes-kunit-modeled-static-base.rbf";
			config-complete-timeout-us = <30000000>;
			scanout {
				compatible = "fes,de25-linux-static-expansion";
			};
			fes-expansion {
				compatible = "fpga-region";
			};
		};
	};
};
